## sdkconfig.defaults
```kconfig
CONFIG_IDF_TARGET="esp32s3"
CONFIG_ESPTOOLPY_FLASHSIZE_16MB=y
CONFIG_ESPTOOLPY_FLASHMODE_DIO=y
CONFIG_ESPTOOLPY_FLASHFREQ_80M=y
CONFIG_SPIRAM=y
CONFIG_SPIRAM_MODE_OCT=y
CONFIG_SPIRAM_SPEED_80M=y
CONFIG_SPIRAM_MEMTEST=y
CONFIG_ESP_DEFAULT_CPU_FREQ_MHZ_240=y
CONFIG_ESP_CONSOLE_UART_DEFAULT=y
CONFIG_ESP_CONSOLE_SECONDARY_NONE=y
CONFIG_COMPILER_OPTIMIZATION_DEBUG=y
CONFIG_LOG_COLORS=n


CONFIG_BT_ENABLED=y
CONFIG_BT_BLUEDROID_ENABLED=y
CONFIG_BT_BLE_ENABLED=y
CONFIG_BT_CLASSIC_ENABLED=n
CONFIG_ESP_COEX_SW_COEXIST_ENABLE=y
CONFIG_LV_FONT_MONTSERRAT_20=y
CONFIG_LV_FONT_MONTSERRAT_24=y
CONFIG_FATFS_LFN_HEAP=y
CONFIG_FATFS_MAX_LFN=255
CONFIG_LV_USE_SNAPSHOT=y
CONFIG_BT_BLE_42_FEATURES_SUPPORTED=y
CONFIG_BT_BLE_42_SCAN_EN=y
CONFIG_BT_BLE_50_FEATURES_SUPPORTED=n
CONFIG_CODEC_I2C_BACKWARD_COMPATIBLE=y
CONFIG_LV_COLOR_16_SWAP=y
CONFIG_LV_MEM_CUSTOM=y
CONFIG_LV_FONT_MONTSERRAT_16=y
CONFIG_LV_FONT_DEFAULT_MONTSERRAT_16=y
CONFIG_FATFS_API_ENCODING_UTF_8=y
CONFIG_LV_FONT_SIMSUN_16_CJK=y
CONFIG_MBEDTLS_CERTIFICATE_BUNDLE=y
CONFIG_MBEDTLS_CERTIFICATE_BUNDLE_DEFAULT_FULL=y
CONFIG_LWIP_SNTP_MAX_SERVERS=2
CONFIG_LV_USE_PNG=y
CONFIG_LV_USE_SJPG=y
CONFIG_LV_USE_FS_STDIO=y
CONFIG_LV_FS_STDIO_LETTER=83
CONFIG_LV_FS_STDIO_PATH="/sdcard"
CONFIG_LV_FS_STDIO_CACHE_SIZE=0
CONFIG_ESP_MAIN_TASK_STACK_SIZE=8192

CONFIG_LV_FONT_FMT_TXT_LARGE=y
CONFIG_LV_IMG_CACHE_DEF_SIZE=0

CONFIG_SPIRAM_ALLOW_BSS_SEG_EXTERNAL_MEMORY=n
CONFIG_SPIRAM_MALLOC_ALWAYSINTERNAL=4096
CONFIG_ESP_WIFI_STATIC_RX_BUFFER_NUM=6
CONFIG_ESP_WIFI_RX_BA_WIN=12
CONFIG_ESP_WIFI_DYNAMIC_RX_BUFFER_NUM=16
CONFIG_ESP_WIFI_DYNAMIC_TX_BUFFER_NUM=16

CONFIG_MBEDTLS_EXTERNAL_MEM_ALLOC=y
CONFIG_BT_ALLOCATION_FROM_SPIRAM_FIRST=y
CONFIG_SPIRAM_TRY_ALLOCATE_WIFI_LWIP=n
CONFIG_WS_BUFFER_SIZE=8192
CONFIG_ESP_WS_CLIENT_SEPARATE_TX_LOCK=y

CONFIG_LV_FONT_MONTSERRAT_48=y
```
